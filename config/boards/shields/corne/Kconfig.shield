## config/boards/shields/corne/Kconfig.shield
```kconfig
# Copyright (c) 2020 Pete Johanson
# SPDX-License-Identifier: MIT

config SHIELD_LUNAKEY_LEFT
	def_bool $(shields_list_contains,corne_left)

config SHIELD_LUNAKEY_RIGHT
	def_bool $(shields_list_contains,corne_right)
```
